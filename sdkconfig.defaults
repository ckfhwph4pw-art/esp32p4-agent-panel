## sdkconfig.defaults
```kconfig
CONFIG_IDF_TARGET="esp32p4"

# ---- 存储与内存 ----
CONFIG_ESPTOOLPY_FLASHSIZE_32MB=y
CONFIG_SPIRAM=y
CONFIG_SPIRAM_MODE_HEX=y
CONFIG_SPIRAM_SPEED_80M=y
CONFIG_SPIRAM_BOOT_INIT=y
CONFIG_SPIRAM_MEMTEST=y

# ---- LVGL + FreeRTOS 成组配置（必须整组，缺一项会导致渲染线程卡死）----
CONFIG_FREERTOS_HZ=1000
CONFIG_LV_OS_FREERTOS=y
CONFIG_LV_USE_CLIB_MALLOC=y
CONFIG_LV_USE_CLIB_STRING=y
CONFIG_LV_USE_CLIB_SPRINTF=y
CONFIG_LV_DEF_REFR_PERIOD=15
CONFIG_LV_OBJ_STYLE_CACHE=y
CONFIG_LV_DRAW_SW_DRAW_UNIT_CNT=2
CONFIG_ESP_MAIN_TASK_STACK_SIZE=10240

# ---- 字体 ----
CONFIG_LV_FONT_MONTSERRAT_20=y
CONFIG_LV_FONT_MONTSERRAT_28=y
CONFIG_LV_FONT_MONTSERRAT_48=y
CONFIG_LV_FONT_FMT_TXT_LARGE=y

# ---- 分区表 ----
CONFIG_PARTITION_TABLE_CUSTOM=y
CONFIG_PARTITION_TABLE_CUSTOM_FILENAME="partitions.csv"

# ---- USB CDC 数据通道（启用后需 reconfigure 才生效）----
CONFIG_TINYUSB_CDC_ENABLED=y
CONFIG_TINYUSB_DESC_PRODUCT_STRING="Agent Panel"
CONFIG_TINYUSB_DESC_SERIAL_STRING="AGP001"
```
